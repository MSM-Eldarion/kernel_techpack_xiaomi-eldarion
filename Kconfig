## Kconfig
```kconfig
source "techpack/xiaomi-eldarion/pmic/Kconfig"
source "techpack/xiaomi-eldarion/touchscreen/Kconfig"
source "techpack/xiaomi-eldarion/ir/Kconfig"
source "techpack/xiaomi-eldarion/leds/Kconfig"
source "techpack/xiaomi-eldarion/fingerprint/Kconfig"
```

## fingerprint/Kconfig
```kconfig
menu "Fingerprint"

source "techpack/xiaomi-eldarion/fingerprint/fpc1020_kenzo/Kconfig"
source "techpack/xiaomi-eldarion/fingerprint/gf318m_kenzo/Kconfig"

endmenu
```

## fingerprint/fpc1020_kenzo/Kconfig
```kconfig
config FINGERPRINT_FPC1020_KENZO
	tristate "FPC1020 fingerprint drvier support"
	help
	  Say Y here to enable fpc fingerprint driver support!
```

## fingerprint/gf318m_kenzo/Kconfig
```kconfig
config FINGERPRINT_GF318M_KENZO
	tristate "Goodix GFX18M fingerprint drvier support"
	help
	  Say Y here to enable goodix fingerprint driver support!
```

## pmic/Kconfig
```kconfig
config LEDS_QPNP
	tristate "Support for QPNP LEDs"
	depends on LEDS_CLASS && SPMI
	help
	  This driver supports the LED functionality of Qualcomm Technologies,
	  Inc. QPNP PMICs.  It primarily supports controlling tri-color RGB
	  LEDs in both PWM and light pattern generator (LPG) modes.  For older
	  PMICs, it also supports WLEDs and flash LEDs.

config QPNP_COINCELL
	tristate "QPNP coincell charger support"
	depends on SPMI
	help
	  This driver supports the QPNP coincell peripheral found inside of
	  Qualcomm Technologies, Inc. QPNP PMIC devices.  The coincell charger
	  provides a means to charge a coincell battery or backup capacitor
	  which is used to maintain PMIC register state when the main battery is
	  removed from the mobile device.
```
