&soc {
    fpc_fpc1020 {
		compatible = "fpc,fpc1020";
		fpc,reset_gpio = <&tlmm 110 0>;
		fpc,irq_gpio = <&tlmm 106 0>;
		fpc,irq_flags = <0x2001>;
		fpc,event-type = <4>;
		fpc,event-code = <4>;
		vcc_spi-supply = <&pm8950_l6>;
		vdd_ana-supply = <&pm8950_l6>;
		vdd_io-supply = <&pm8950_l6>;
	};

	goodix_gf318m {
		compatible = "goodix,fingerprint";

		vcc_spi-supply  = <&pm8950_l10>;
		vdd_ana-supply  = <&pm8950_l10>;
		vdd_io-supply   = <&pm8950_l10>;

		goodix,gpio_reset =<&tlmm 110 0>;
		goodix,gpio_irq = <&tlmm 106 0>;
		goodix,gpio_pwr = <&tlmm 119 0>;
	};
};